## config/west.yml
```yaml
manifest:
  remotes:
    - name: zmkfirmware
      url-base: https://github.com/zmkfirmware
    - name: turnipblue                         # new entry
      url-base: https://github.com/TurnipBlue  # new entry
  projects:
    - name: zmk
      remote: zmkfirmware
      revision: main
      import: app/west.yml
    - name: nice-view-module  # new entry
      remote: turnipblue      # new entry
      revision: main          # new entry
  self:
    path: config
```
